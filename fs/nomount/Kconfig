## fs/nomount/Kconfig
```kconfig
# Kconfig for NoMount

config NOMOUNT
	tristate "NoMount Path Redirection Subsystem"
	depends on KSU
	default n
	help
	  NoMount allows path redirection and virtual file injection
	  without mounting filesystems. Useful for systemless modifications.
```
